## boards/arm/nrf52833_herald_base/Kconfig.board
```kconfig
# Herald Wearable - Base device

# Copyright (c) 2021 The Herald Project Contributors
# SPDX-License-Identifier: Apache-2.0

config BOARD_NRF52833_HERALD_BASE
	bool "nRF52 HERALD BASE"
	depends on SOC_NRF52833_QIAA
```

## boards/arm/nrf52833_herald_base/Kconfig.defconfig
```kconfig
# Herald Wearable - Base device board configuration

# Copyright (c) 2021 The Herald Project Contributors
# SPDX-License-Identifier: Apache-2.0

if BOARD_NRF52833_HERALD_BASE

config BOARD
	default "nrf52833_herald_base"

config BT_CTLR
	default BT

endif # BOARD_NRF52833_HERALD_BASE
```

## boards/arm/nrf52833_herald_base/nrf52833_herald_base_defconfig
```kconfig
# SPDX-License-Identifier: Apache-2.0

CONFIG_SOC_SERIES_NRF52X=y
CONFIG_SOC_NRF52833_QIAA=y
CONFIG_BOARD_NRF52833_HERALD_BASE=y

# Enable MPU
CONFIG_ARM_MPU=y

# Standard LIS2DE12 settings
CONFIG_I2C=y
CONFIG_SENSOR=y
CONFIG_LIS2DH=y
CONFIG_LIS2DH_OPER_MODE_LOW_POWER=y
CONFIG_LIS2DH_ODR_9_LOW=y
```
